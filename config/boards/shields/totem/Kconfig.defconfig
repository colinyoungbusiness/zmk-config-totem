## config/boards/shields/totem/Kconfig.defconfig
```kconfig
# Copyright (c) 2026 The ZMK Contributors
# SPDX-License-Identifier: MIT

if SHIELD_ARTSEY_FOUNDRY

config ZMK_KEYBOARD_NAME
    default "Artsey Foundry"

endif
```

## config/boards/shields/totem/Kconfig.shield
```kconfig
# Copyright (c) 2026 The ZMK Contributors
# SPDX-License-Identifier: MIT

config SHIELD_ARTSEY_FOUNDRY
    def_bool $(shields_list_contains,artsey_foundry)
```
